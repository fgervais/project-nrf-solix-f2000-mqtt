## west.yml
```yaml
manifest:
  remotes:
    - name: ncs
      url-base: https://github.com/nrfconnect
  projects:
    - name: nrf
      repo-path: sdk-nrf
      remote: ncs
      revision: v2.8.0
      import: true
    - name: zephyr-my-boards
      url: https://github.com/fgervais/zephyr-my-boards
      revision: 645286ceea6c5e7558a83934c85a4c3adb57983d
      path: myboards
    - name: zephyr-mymodule-base
      url: https://github.com/fgervais/zephyr-mymodule-base.git
      revision: a4a6118ce6af3d05017d148487e20f99e443976b
      path: mymodules/base
  self:
    path: application
```
